## src/modules/logger/Kconfig
```kconfig
menuconfig MODULES_LOGGER
	bool "logger"
	default n
	---help---
		Enable support for logger

menuconfig USER_LOGGER
	bool "logger running as userspace module"
	default y
	depends on BOARD_PROTECTED && MODULES_LOGGER
	---help---
		Put logger in userspace memory

menuconfig LOGGER_STACK_SIZE
	int "stack size of logger task"
	default 3700
	depends on MODULES_LOGGER
	---help---
		Stack size of the logger task. Some configurations require more stack
		than the default.

menuconfig LOGGER_PREARM
	bool "pre-arm rolling log buffer"
	default n
	depends on MODULES_LOGGER
	---help---
		Continuously buffer the last 30 seconds of log data in RAM from boot,
		and splice it into the log file when the vehicle arms, so every flight
		log includes the seconds leading up to arming. Requires a few MB of
		free RAM; only enable on boards with sufficient headroom.
```
